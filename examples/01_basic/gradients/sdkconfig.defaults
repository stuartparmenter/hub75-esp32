## examples/01_basic/gradients/sdkconfig.defaults
```kconfig
# ESP-IDF default configuration for gradients example

# HUB75 Panel Settings (typical 64x64 panel)
CONFIG_HUB75_PANEL_WIDTH=64
CONFIG_HUB75_PANEL_HEIGHT=64
CONFIG_HUB75_SCAN_1_32=y
CONFIG_HUB75_WIRING_STANDARD=y
CONFIG_HUB75_DRIVER_GENERIC=y

# Single panel layout
CONFIG_HUB75_LAYOUT_ROWS=1
CONFIG_HUB75_LAYOUT_COLS=1
CONFIG_HUB75_LAYOUT_HORIZONTAL=y

# Performance settings (higher bit depth recommended for smoother gradients)
CONFIG_HUB75_BIT_DEPTH_10=y
CONFIG_HUB75_CLK_10MHZ=y
CONFIG_HUB75_MIN_REFRESH_RATE=60
CONFIG_HUB75_BRIGHTNESS=255

# Component features
CONFIG_HUB75_DOUBLE_BUFFER=n
CONFIG_HUB75_TEMPORAL_DITHER=y  # Helps with gradient smoothness
CONFIG_HUB75_IRAM_OPTIMIZATION=y

# Board preset (user should configure via menuconfig)
CONFIG_HUB75_BOARD_CUSTOM=y
```

## examples/02_multi_panel/layout_demo/sdkconfig.defaults
```kconfig
# Multi-Panel Layout Configuration Demo
#
# This example demonstrates different ways to chain multiple HUB75 panels.
# Edit the layout settings below to match your physical panel arrangement.
# See README.md for wiring diagrams and physical panel orientation.

# HUB75 Panel Settings (dimensions of a SINGLE panel)
CONFIG_HUB75_PANEL_WIDTH=64
CONFIG_HUB75_PANEL_HEIGHT=64
CONFIG_HUB75_SCAN_1_32=y
CONFIG_HUB75_WIRING_STANDARD=y
CONFIG_HUB75_DRIVER_GENERIC=y

# ============================================================================
# CURRENT LAYOUT: 2 panels horizontal (side-by-side)
# ============================================================================
CONFIG_HUB75_LAYOUT_ROWS=1
CONFIG_HUB75_LAYOUT_COLS=2
CONFIG_HUB75_LAYOUT_HORIZONTAL=y

# ============================================================================
# OTHER LAYOUT OPTIONS (uncomment to try different arrangements)
# ============================================================================

# --- 3 panels horizontal (side-by-side-by-side) ---
# Total virtual display: 192x64 pixels
# Wiring: [Panel 0] → [Panel 1] → [Panel 2]
#
# CONFIG_HUB75_LAYOUT_ROWS=1
# CONFIG_HUB75_LAYOUT_COLS=3
# CONFIG_HUB75_LAYOUT_HORIZONTAL=y

# --- 2x2 serpentine grid (alternate rows upside down) ---
# Total virtual display: 128x128 pixels
# Panel orientation: Row 0 panels upright, Row 1 panels upside down
# Wiring: [Panel 0] → [Panel 1] ↓
#                    [Panel 3] ← [Panel 2]
# Saves cable length between rows but requires physical panel rotation
#
# CONFIG_HUB75_LAYOUT_ROWS=2
# CONFIG_HUB75_LAYOUT_COLS=2
# CONFIG_HUB75_LAYOUT_TOP_LEFT_DOWN=y

# --- 3x2 serpentine grid (6 panels, alternate rows upside down) ---
# Total virtual display: 192x128 pixels
# Wiring: [Panel 0] → [Panel 1] → [Panel 2] ↓
#                    [Panel 5] ← [Panel 4] ← [Panel 3]
#
# CONFIG_HUB75_LAYOUT_ROWS=2
# CONFIG_HUB75_LAYOUT_COLS=3
# CONFIG_HUB75_LAYOUT_TOP_LEFT_DOWN=y

# --- 2x2 zigzag grid (all panels upright, longer cables) ---
# Total virtual display: 128x128 pixels
# Panel orientation: All panels remain upright (no physical rotation)
# Wiring: [Panel 0] → [Panel 1] ↓
#         [Panel 2] ← [Panel 3] (cable routes back)
# Requires longer cables but simpler physical installation
#
# CONFIG_HUB75_LAYOUT_ROWS=2
# CONFIG_HUB75_LAYOUT_COLS=2
# CONFIG_HUB75_LAYOUT_TOP_LEFT_DOWN_ZIGZAG=y

# ============================================================================
# Performance Settings
# ============================================================================
CONFIG_HUB75_BIT_DEPTH_8=y
CONFIG_HUB75_CLK_10MHZ=y
CONFIG_HUB75_MIN_REFRESH_RATE=60
CONFIG_HUB75_BRIGHTNESS=255

# Component features
CONFIG_HUB75_DOUBLE_BUFFER=n
CONFIG_HUB75_TEMPORAL_DITHER=n
CONFIG_HUB75_IRAM_OPTIMIZATION=y

# Board preset (configure pins via menuconfig)
CONFIG_HUB75_BOARD_CUSTOM=y
```

## examples/03_lvgl/simple_demo/sdkconfig.defaults
```kconfig
# ESP-IDF default configuration for LVGL demo example

# HUB75 Panel Settings
CONFIG_HUB75_PANEL_WIDTH=64
CONFIG_HUB75_PANEL_HEIGHT=64
CONFIG_HUB75_SCAN_1_32=y
CONFIG_HUB75_WIRING_STANDARD=y
CONFIG_HUB75_DRIVER_GENERIC=y

# Single panel layout
CONFIG_HUB75_LAYOUT_ROWS=1
CONFIG_HUB75_LAYOUT_COLS=1
CONFIG_HUB75_LAYOUT_HORIZONTAL=y

# Performance settings
CONFIG_HUB75_BIT_DEPTH_8=y
CONFIG_HUB75_CLK_10MHZ=y
CONFIG_HUB75_MIN_REFRESH_RATE=60
CONFIG_HUB75_BRIGHTNESS=128

# Component features
CONFIG_HUB75_DOUBLE_BUFFER=n
CONFIG_HUB75_TEMPORAL_DITHER=n
CONFIG_HUB75_IRAM_OPTIMIZATION=y

# Board preset
CONFIG_HUB75_BOARD_CUSTOM=y

# LVGL Configuration
CONFIG_LV_COLOR_DEPTH_16=y
CONFIG_LV_USE_PERF_MONITOR=n
CONFIG_LV_USE_MEM_MONITOR=n

# FreeRTOS Configuration
CONFIG_FREERTOS_HZ=1000
```

## examples/common/sdkconfig.defaults.esp32p4
```kconfig
# ESP32-P4 specific configuration (shared across all examples)

# PSRAM Configuration (REQUIRED for ESP32-P4 PARLIO)
CONFIG_IDF_EXPERIMENTAL_FEATURES=y
CONFIG_SPIRAM=y
CONFIG_SPIRAM_SPEED_200M=y
CONFIG_SPIRAM_IGNORE_NOTFOUND=y

# Main task stack size (may be needed for some examples)
CONFIG_ESP_MAIN_TASK_STACK_SIZE=8192
```

## main/Kconfig.projbuild
```kconfig
# SPDX-FileCopyrightText: 2025 Stuart Parmenter
# SPDX-License-Identifier: MIT

menu "HUB75 Example Selection"

    choice EXAMPLE_SELECTION
        prompt "Example to Build"
        default EXAMPLE_SMOKE_TEST
        help
            Select which example to build in the main/ directory.

            Examples are also available in examples/ and can be built standalone
            by navigating to the example directory and running 'idf.py build'.

            All HUB75 hardware configuration (pins, panel settings, etc.) is
            available under "Component config → HUB75 RGB LED Matrix Driver".

        config EXAMPLE_SMOKE_TEST
            bool "Smoke Test (Quick Validation)"
            help
                Simple colored squares in corners + center cross.
                Fast build for quick hardware validation.

        config EXAMPLE_SIMPLE_COLORS
            bool "01_basic/simple_colors"
            help
                RGB corner squares, white square, cyan cross.
                Basic pixel drawing demonstration.

        config EXAMPLE_GRADIENTS
            bool "01_basic/gradients"
            help
                Smooth color transitions (horizontal, vertical, radial).
                Demonstrates color blending and gradient rendering.

        config EXAMPLE_BRIGHTNESS
            bool "01_basic/brightness"
            help
                Brightness control: fade in/out, pulse animation.
                Shows runtime brightness adjustment.

        config EXAMPLE_TWO_HORIZONTAL
            bool "02_multi_panel/two_horizontal"
            help
                2×1 layout (128×64 from two 64×64 panels).
                Demonstrates horizontal panel chaining.

        config EXAMPLE_THREE_HORIZONTAL
            bool "02_multi_panel/three_horizontal"
            help
                3×1 layout (192×64 from three 64×64 panels).
                Shows longer horizontal chains.

        config EXAMPLE_SERPENTINE
            bool "02_multi_panel/serpentine"
            help
                2×1 serpentine wiring pattern demonstration.
                Explains coordinate remapping for alternate rows.

        config EXAMPLE_LVGL_DEMO
            bool "03_lvgl/simple_demo"
            help
                LVGL integration: labels, buttons, brightness slider.
                Requires LVGL dependency (pulled via idf_component.yml).
    endchoice

endmenu
```
